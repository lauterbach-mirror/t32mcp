LOCAL &ppd
&ppd=OS.PresentPracticeDirectory()

BREAK

DO &ppd/get_state.cmm

ENDDO
; SPDX-FileCopyrightText: 1989-2026 Lauterbach GmbH
; SPDX-License-Identifier: Apache-2.0
; {
;   "interface": 1,
;   "strict": true,
;   "arguments": {
;     "wait": {"type": "number", "optional": true}
;   }
; }
;
; Example:
; { "wait": "1000." }

; ----- MCP tool script setup boilerplate ---------------
; prepare error handling and AREA window print output
ERROR.RESet
ON ERROR JUMPTO errorcleanup
PRinTer.Area

; get the current script path
LOCAL &script_file &abs_path
&script_file=OS.PresentPracticeFile()
&abs_path=OS.FILE.ABSPATH("&script_file")

; macros for input line and parsed input vars
PRIVATE &line &wait &start_time &elapsed
; read input line
ENTRY %LINE &line

; output header
PRINT ""
PRINT %WARNING "[MCP start] (&abs_path), args: &line"

; parse, validate, and transform input data
; wait time in milliseconds, 0. = keep running
&wait=STRing.SCANAndExtract("&line","wait=","0.")
; a non-numeric value already fails here and jumps to errorcleanup, before the target starts
IF &wait<0.
(
  PRINT %ERROR "Error: parameter 'wait' must be a positive decimal number of milliseconds, e.g. 1000."
  PRINT %WARNING "[MCP end]"
  ENDDO
)

IF !SYStem.Up()
(
  PRINT %ERROR "Error: system is not up (" STATE.TARGET() "). Ask the user to bring the target up."
  PRINT %WARNING "[MCP end]"
  ENDDO
)

; ----- main script logic -------------------------------
IF STATE.RUN()
(
  PRINT %WARNING "Warning: target was already running."
)
ELSE
(
  Go
  PRINT "Success: target is running."
)

IF &wait==0.
(
  PRINT "No timeout. The target keeps running until a breakpoint hits or set_halted.cmm is called."
)
ELSE
(
  &start_time=OS.TIMER()
  WAIT !STATE.RUN() &(wait)ms
  IF STATE.RUN()
  (
    Break
    WAIT !STATE.RUN() 1.s
    PRINT "Halted after the timeout of &wait ms."
  )
  ELSE
  (
    &elapsed=OS.TIMER()-&start_time
    PRINT "Stopped before the timeout, after " %Decimal &elapsed ". ms."
  )
)

IF !STATE.RUN()
(
  PRINT "State: " STATE.TARGET()
  PRINT "Stopped at: " PP() " in " sYmbol.FUNCTION(PP())
)

; ----- cleanup and error handling boilerplate ----------
JUMPTO cleanup

errorcleanup:
(
  ; prevent further nested errors - could lead to infinite loop
  ON ERROR CONTinue
  PRINT %ERROR "^^^ (error message on previous line): Encountered error during execution, caused by '" ERROR.CMDLINE() "'"
  PRINT %ERROR "[t32mcp: script failed]"
  PRINT %WARNING "[MCP end]"
  ERROR.RESet
  ON ERROR inherit
  ENDDO
)

cleanup:
(
  PRINT %WARNING "[MCP end]"
  ON ERROR inherit
  ENDDO
)

; SPDX-FileCopyrightText: 1989-2026 Lauterbach GmbH
; SPDX-License-Identifier: Apache-2.0
; {
;   "interface": 1,
;   "strict": true,
;   "arguments": {
;     "file": {"type": "string"},
;     "line": {"type": "number"}
;   }
; }
;
; Example:
; { "file": "main.c", "line": "13." }

; ----- MCP tool script setup boilerplate ---------------
; prepare error handling and AREA window print output
ERROR.RESet
ON ERROR JUMPTO errorcleanup
PRinTer.Area

; get the current script path
LOCAL &script_file &abs_path
&script_file=OS.PresentPracticeFile()
&abs_path=OS.FILE.ABSPATH("&script_file")

; macros for input line and parsed input vars
PRIVATE &line &file &line_nr
; read input line
ENTRY %LINE &line

; output header
PRINT ""
PRINT %WARNING "[MCP start] (&abs_path), args: &line"

; parse, validate, and transform input data
&file=STRing.SCANAndExtract("&line","file=","")
&line_nr=STRing.SCANAndExtract("&line","line=","")
IF "&file"==""
(
  PRINT %ERROR "Error: parameter 'file' is required, e.g. main.c."
  PRINT %WARNING "[MCP end]"
  ENDDO
)
IF "&line_nr"==""
(
  PRINT %ERROR "Error: parameter 'line' is required, e.g. 13."
  PRINT %WARNING "[MCP end]"
  ENDDO
)
; the line number in a symbol path is always decimal and must not have a trailing dot
&line_nr=STRing.Replace("&line_nr",".","",0.)

; ----- main script logic -------------------------------
Break.Set \"&file"\&line_nr
PRINT "Success: breakpoint set at &file:&line_nr."

; ----- cleanup and error handling boilerplate ----------
JUMPTO cleanup

errorcleanup:
(
  ; prevent further nested errors - could lead to infinite loop
  ON ERROR CONTinue
  PRINT %ERROR "^^^ (error message on previous line): Encountered error during execution, caused by '" ERROR.CMDLINE() "'"
  PRINT %ERROR "[t32mcp: script failed]"
  PRINT %WARNING "[MCP end]"
  ERROR.RESet
  ON ERROR inherit
  ENDDO
)

cleanup:
(
  PRINT %WARNING "[MCP end]"
  ON ERROR inherit
  ENDDO
)

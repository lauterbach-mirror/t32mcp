; { "interface": 1, "strict": true }

PRINT "plain line"
PRINT %WARNING "warning line"
PRINT %ERROR "error line"
PRINT "last line"
ENDDO

; SPDX-FileCopyrightText: 1989-2026 Lauterbach GmbH
; SPDX-License-Identifier: Apache-2.0
; {
;   "interface": 1,
;   "strict": true,
;   "arguments": {
;   }
; }
;
; Example:
; { }

; ----- MCP tool script setup boilerplate ---------------
; prepare error handling and AREA window print output
ERROR.RESet
ON ERROR JUMPTO errorcleanup
PRinTer.Area

; get the current script path
LOCAL &script_file &abs_path
&script_file=OS.PresentPracticeFile()
&abs_path=OS.FILE.ABSPATH("&script_file")

; macros for input line and parsed input vars
PRIVATE &line
; read input line
ENTRY %LINE &line

; output header
PRINT ""
PRINT %WARNING "[MCP start] (&abs_path), args: &line"

IF !SYStem.Up()
(
  PRINT %ERROR "Error: system is not up (" STATE.TARGET() "). Ask the user to bring the target up."
  PRINT %WARNING "[MCP end]"
  ENDDO
)

; ----- main script logic -------------------------------
IF STATE.RUN()
(
  Break
  WAIT !STATE.RUN() 1.s
  PRINT "Success: target halted."
)
ELSE
(
  PRINT %WARNING "Warning: target was already halted."
)

PRINT "State: " STATE.TARGET()
IF !STATE.RUN()
(
  PRINT "Function: " sYmbol.FUNCTION(PP())
  WinPrint.Register
)

; ----- cleanup and error handling boilerplate ----------
JUMPTO cleanup

errorcleanup:
(
  ; prevent further nested errors - could lead to infinite loop
  ON ERROR CONTinue
  PRINT %ERROR "^^^ (error message on previous line): Encountered error during execution, caused by '" ERROR.CMDLINE() "'"
  PRINT %ERROR "[t32mcp: script failed]"
  PRINT %WARNING "[MCP end]"
  ERROR.RESet
  ON ERROR inherit
  ENDDO
)

cleanup:
(
  PRINT %WARNING "[MCP end]"
  ON ERROR inherit
  ENDDO
)

PRINT "before"
AREA.Create t32mcp_test_area
PRINT "after"
ENDDO

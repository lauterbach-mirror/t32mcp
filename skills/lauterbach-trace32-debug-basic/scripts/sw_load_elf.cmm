; SPDX-FileCopyrightText: 1989-2026 Lauterbach GmbH
; SPDX-License-Identifier: Apache-2.0
; {
;   "interface": 1,
;   "strict": true,
;   "arguments": {
;     "file": {"type": "string"}
;   }
; }
;
; Example:
; { "file": "app.elf" }

; ----- MCP tool script setup boilerplate ---------------
; prepare error handling and AREA window print output
ERROR.RESet
ON ERROR JUMPTO errorcleanup
PRinTer.Area

; get the current script path
LOCAL &script_file &abs_path
&script_file=OS.PresentPracticeFile()
&abs_path=OS.FILE.ABSPATH("&script_file")

; macros for input line and parsed input vars
PRIVATE &line &file
; read input line
ENTRY %LINE &line

; output header
PRINT ""
PRINT %WARNING "[MCP start] (&abs_path), args: &line"

; parse, validate, and transform input data
&file=STRing.SCANAndExtract("&line","file=","")
IF "&file"==""
(
  PRINT %ERROR "Error: parameter 'file' is required, e.g. app.elf."
  PRINT %WARNING "[MCP end]"
  ENDDO
)
IF !OS.FILE.readable("&file")
(
  PRINT %ERROR "Error: file '&file' does not exist on the PowerView host."
  PRINT %WARNING "[MCP end]"
  ENDDO
)
IF STATE.RUN()
(
  PRINT %ERROR "Error: target is running, halt it first (set_halted.cmm)."
  PRINT %WARNING "[MCP end]"
  ENDDO
)

; ----- main script logic -------------------------------
Data.LOAD.Elf "&file"
PRINT "Success: loaded '&file'."

; ----- cleanup and error handling boilerplate ----------
JUMPTO cleanup

errorcleanup:
(
  ; prevent further nested errors - could lead to infinite loop
  ON ERROR CONTinue
  PRINT %ERROR "^^^ (error message on previous line): Encountered error during execution, caused by '" ERROR.CMDLINE() "'"
  PRINT %ERROR "[t32mcp: script failed]"
  PRINT %WARNING "[MCP end]"
  ERROR.RESet
  ON ERROR inherit
  ENDDO
)

cleanup:
(
  PRINT %WARNING "[MCP end]"
  ON ERROR inherit
  ENDDO
)

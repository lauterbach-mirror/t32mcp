; SPDX-FileCopyrightText: 1989-2026 Lauterbach GmbH
; SPDX-License-Identifier: Apache-2.0
; {
;   "interface": 1,
;   "strict": true,
;   "arguments": {
;     "from": {"type": "string"},
;     "to": {"type": "string"}
;   }
; }
;
; Example:
; { "from": "C:/work/src", "to": "C:/project/src" }

; ----- MCP tool script setup boilerplate ---------------
; prepare error handling and AREA window print output
ERROR.RESet
ON ERROR JUMPTO errorcleanup
PRinTer.Area

; get the current script path
LOCAL &script_file &abs_path
&script_file=OS.PresentPracticeFile()
&abs_path=OS.FILE.ABSPATH("&script_file")

; macros for input line and parsed input vars
PRIVATE &line &from &to &file
; read input line
ENTRY %LINE &line

; output header
PRINT ""
PRINT %WARNING "[MCP start] (&abs_path), args: &line"

; parse, validate, and transform input data
&from=STRing.SCANAndExtract("&line","from=","")
&to=STRing.SCANAndExtract("&line","to=","")
IF "&from"==""
(
  PRINT %ERROR "Error: parameter 'from' is required, e.g. C:/work/src."
  PRINT %WARNING "[MCP end]"
  ENDDO
)
IF "&to"==""
(
  PRINT %ERROR "Error: parameter 'to' is required, e.g. C:/project/src."
  PRINT %WARNING "[MCP end]"
  ENDDO
)

; ----- main script logic -------------------------------
sYmbol.SourcePATH.Translate "&from" "&to"
sYmbol.SourceRELOAD
PRINT "Success: translated source path '&from' -> '&to'."
; remaining source files that cannot be found, with the full path from the debug information
PRINT "Source files still not found:"
&file=sYmbol.List.SOURCE(1.,2.,1.)
WHILE "&file"!=""
(
  PRINT "  &file"
  &file=sYmbol.List.SOURCE(0.,2.,0.)
)

; ----- cleanup and error handling boilerplate ----------
JUMPTO cleanup

errorcleanup:
(
  ; prevent further nested errors - could lead to infinite loop
  ON ERROR CONTinue
  PRINT %ERROR "^^^ (error message on previous line): Encountered error during execution, caused by '" ERROR.CMDLINE() "'"
  PRINT %ERROR "[t32mcp: script failed]"
  PRINT %WARNING "[MCP end]"
  ERROR.RESet
  ON ERROR inherit
  ENDDO
)

cleanup:
(
  PRINT %WARNING "[MCP end]"
  ON ERROR inherit
  ENDDO
)
